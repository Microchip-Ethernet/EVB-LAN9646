## ung_apps_external/Config.in
```kconfig
menu "Microchip UNG applications"
	source "$BR2_EXTERNAL_KSZ_PATH/package/microchip/Config.in"
	source "$BR2_EXTERNAL_KSZ_PATH/package/ung_cmake/Config.in"
endmenu
```

## ung_apps_external/configs/sam9x75_curiosity_mmc_defconfig
```kconfig
BR2_arm=y
BR2_TOOLCHAIN_BUILDROOT_UCLIBC=y
BR2_DL_DIR="$(TOPDIR)/../buildroot-dl"
BR2_GLOBAL_PATCH_DIR="$(BR2_EXTERNAL_KSZ_PATH)/patches"
BR2_ROOTFS_OVERLAY="$(BR2_EXTERNAL_KSZ_PATH)/board/microchip/sam9x75_curiosity/rootfs_overlay"
BR2_ROOTFS_POST_BUILD_SCRIPT="$(BR2_EXTERNAL_KSZ_PATH)/board/microchip/sam9x75_curiosity/post-build.sh"
BR2_ROOTFS_POST_IMAGE_SCRIPT="$(BR2_EXTERNAL_KSZ_PATH)/board/microchip/sam9x75_curiosity/post-image.sh"
BR2_LINUX_KERNEL=y
BR2_LINUX_KERNEL_CUSTOM_TARBALL=y
BR2_LINUX_KERNEL_CUSTOM_TARBALL_LOCATION="$(call github,linux4microchip,linux,linux4microchip-2023.10)/linux-linux4microchip-2023.10.tar.gz"
BR2_LINUX_KERNEL_PATCH="$(BR2_EXTERNAL_KSZ_PATH)/patches/linux-linux4microchip-2023.10"
BR2_LINUX_KERNEL_USE_CUSTOM_CONFIG=y
BR2_LINUX_KERNEL_CUSTOM_CONFIG_FILE="$(BR2_EXTERNAL_KSZ_PATH)/board/microchip/sam9x75_curiosity/sam9x75_curiosity_dsa_defconfig"
BR2_LINUX_KERNEL_DTS_SUPPORT=y
BR2_LINUX_KERNEL_INTREE_DTS_NAME="at91-sam9x75_curiosity_lan9646"
BR2_LINUX_KERNEL_NEEDS_HOST_OPENSSL=y
BR2_PACKAGE_BUSYBOX_CONFIG="$(BR2_EXTERNAL_KSZ_PATH)/board/microchip/sam9x75_curiosity/busybox.config"
BR2_PACKAGE_DOSFSTOOLS=y
BR2_PACKAGE_DOSFSTOOLS_FSCK_FAT=y
BR2_PACKAGE_E2FSPROGS=y
BR2_PACKAGE_UBOOT_TOOLS=y
BR2_PACKAGE_BRIDGE_UTILS=y
BR2_PACKAGE_EASYFRAMES=y
BR2_PACKAGE_ETHTOOL=y
BR2_PACKAGE_IPERF3=y
BR2_PACKAGE_IPROUTE2=y
BR2_PACKAGE_NUTTCP=y
BR2_PACKAGE_TCPDUMP=y
BR2_TARGET_ROOTFS_EXT2=y
BR2_TARGET_ROOTFS_EXT2_4=y
BR2_TARGET_AT91BOOTSTRAP3=y
BR2_TARGET_AT91BOOTSTRAP3_CUSTOM_TARBALL=y
BR2_TARGET_AT91BOOTSTRAP3_CUSTOM_TARBALL_LOCATION="$(call github,linux4sam,at91bootstrap,v4.0.8)/at91bootstrap3-v4.0.8.tar.gz"
BR2_TARGET_AT91BOOTSTRAP3_DEFCONFIG="sam9x75_curiositysd_uboot"
BR2_TARGET_UBOOT=y
BR2_TARGET_UBOOT_BUILD_SYSTEM_KCONFIG=y
BR2_TARGET_UBOOT_CUSTOM_GIT=y
BR2_TARGET_UBOOT_CUSTOM_REPO_URL="https://github.com/linux4microchip/u-boot-mchp.git"
BR2_TARGET_UBOOT_CUSTOM_REPO_VERSION="linux4microchip-2023.10"
BR2_TARGET_UBOOT_PATCH="$(BR2_EXTERNAL_KSZ_PATH)/patches/u-boot-mchp-linux4microchip-2023.10"
BR2_TARGET_UBOOT_BOARD_DEFCONFIG="sam9x75_curiosity_dev_mmc"
BR2_TARGET_UBOOT_NEEDS_DTC=y
BR2_PACKAGE_HOST_DOSFSTOOLS=y
BR2_PACKAGE_HOST_GENIMAGE=y
BR2_PACKAGE_HOST_MTOOLS=y
BR2_PACKAGE_HOST_UBOOT_TOOLS=y
BR2_PACKAGE_HOST_UBOOT_TOOLS_ENVIMAGE=y
BR2_PACKAGE_HOST_UBOOT_TOOLS_ENVIMAGE_SOURCE="$(BR2_EXTERNAL_KSZ_PATH)/board/microchip/sam9x75_curiosity/uboot-mmc.txt"
BR2_PACKAGE_HOST_UBOOT_TOOLS_ENVIMAGE_SIZE="0x4000"
BR2_PACKAGE_KSZ_LINUXPTP=y
BR2_PACKAGE_KSZ_LINUXPTP_3_1_1=y
BR2_PACKAGE_KSZ_LINUXPTP_4_0_0=y
BR2_PACKAGE_KSZ_REGS_BIN=y
BR2_PACKAGE_KSZ_PTP_CLI=y
BR2_PACKAGE_KSZ_PTP_TEST=y
BR2_PACKAGE_KSZ_OPENAVB=y
BR2_PACKAGE_MDIO_TOOL=y
BR2_PACKAGE_WEB_GUI=y
BR2_PACKAGE_KSZ_LAN8770_APP=y
BR2_PACKAGE_EASYRUN=y
BR2_PACKAGE_EF_LOOP=y
```

## ung_apps_external/configs/sama7d65_curiosity_6_12_mmc_defconfig
```kconfig
BR2_arm=y
BR2_cortex_a7=y
BR2_ARM_FPU_NEON_VFPV4=y
BR2_TOOLCHAIN_BUILDROOT_UCLIBC=y
BR2_TOOLCHAIN_BUILDROOT_CXX=y
BR2_DL_DIR="$(TOPDIR)/../buildroot-dl"
BR2_CCACHE=y
BR2_GLOBAL_PATCH_DIR="$(BR2_EXTERNAL_KSZ_PATH)/patches"
BR2_TARGET_GENERIC_HOSTNAME="sama7"
BR2_TARGET_GENERIC_ISSUE="Welcome to the Microchip SAMA7D65 CURIOSITY Demo"
BR2_SYSTEM_DHCP="eth0"
BR2_ROOTFS_OVERLAY="$(BR2_EXTERNAL_KSZ_PATH)/board/microchip/sama7d65_curiosity/rootfs_overlay"
BR2_ROOTFS_POST_BUILD_SCRIPT="$(BR2_EXTERNAL_KSZ_PATH)/board/microchip/sama7d65_curiosity/post-build.sh"
BR2_ROOTFS_POST_IMAGE_SCRIPT="$(BR2_EXTERNAL_KSZ_PATH)/board/microchip/sama7d65_curiosity/post-image.sh"
BR2_LINUX_KERNEL=y
BR2_LINUX_KERNEL_CUSTOM_TARBALL=y
BR2_LINUX_KERNEL_CUSTOM_TARBALL_LOCATION="$(call github,linux4microchip,linux,linux4microchip-2025.04)/linux-linux4microchip-2025.04.tar.gz"
BR2_LINUX_KERNEL_PATCH="$(BR2_EXTERNAL_KSZ_PATH)/patches/linux-linux4microchip-2025.04"
BR2_LINUX_KERNEL_USE_CUSTOM_CONFIG=y
BR2_LINUX_KERNEL_CUSTOM_CONFIG_FILE="$(BR2_EXTERNAL_KSZ_PATH)/board/microchip/sama7d65_curiosity/sama7_6_12_ksz_defconfig"
BR2_LINUX_KERNEL_DTS_SUPPORT=y
BR2_LINUX_KERNEL_INTREE_DTS_NAME="microchip/at91-sama7d65_curiosity_ksz9477"
BR2_LINUX_KERNEL_NEEDS_HOST_OPENSSL=y
BR2_PACKAGE_LINUX_TOOLS_GPIO=y
BR2_PACKAGE_LINUX_TOOLS_IIO=y
BR2_PACKAGE_BUSYBOX_CONFIG="$(BR2_EXTERNAL_KSZ_PATH)/board/microchip/sam9x75_curiosity/busybox.config"
BR2_PACKAGE_E2FSPROGS=y
BR2_PACKAGE_MMC_UTILS=y
BR2_PACKAGE_MTD=y
# BR2_PACKAGE_RNG_TOOLS_JITTERENTROPY_LIBRARY is not set
BR2_PACKAGE_SETSERIAL=y
BR2_PACKAGE_SPI_TOOLS=y
BR2_PACKAGE_UBOOT_TOOLS=y
BR2_PACKAGE_DTC=y
BR2_PACKAGE_DTC_PROGRAMS=y
BR2_PACKAGE_BRIDGE_UTILS=y
BR2_PACKAGE_CAN_UTILS=y
BR2_PACKAGE_EASYFRAMES=y
BR2_PACKAGE_ETHTOOL=y
BR2_PACKAGE_IPERF3=y
BR2_PACKAGE_IPROUTE2=y
BR2_PACKAGE_IW=y
BR2_PACKAGE_MII_DIAG=y
BR2_PACKAGE_NUTTCP=y
BR2_PACKAGE_PHYTOOL=y
BR2_PACKAGE_TCPDUMP=y
BR2_PACKAGE_TRACEROUTE=y
BR2_PACKAGE_FILE=y
BR2_TARGET_ROOTFS_EXT2=y
BR2_TARGET_ROOTFS_EXT2_4=y
BR2_TARGET_ROOTFS_EXT2_LABEL="ROOTFS"
BR2_TARGET_ROOTFS_EXT2_SIZE="512M"
BR2_TARGET_AT91BOOTSTRAP3=y
BR2_TARGET_AT91BOOTSTRAP3_CUSTOM_GIT=y
BR2_TARGET_AT91BOOTSTRAP3_CUSTOM_REPO_URL="https://github.com/linux4sam/at91bootstrap.git"
BR2_TARGET_AT91BOOTSTRAP3_CUSTOM_REPO_VERSION="sama7d65-ea-1.0"
BR2_TARGET_AT91BOOTSTRAP3_CUSTOM_PATCH_DIR="$(BR2_EXTERNAL_KSZ_PATH)/patches/at91bootstrap-sama7d65-ea"
BR2_TARGET_AT91BOOTSTRAP3_DEFCONFIG="sama7d65_curiosity-bsrsd1_uboot"
BR2_TARGET_UBOOT=y
BR2_TARGET_UBOOT_BUILD_SYSTEM_KCONFIG=y
BR2_TARGET_UBOOT_CUSTOM_GIT=y
BR2_TARGET_UBOOT_CUSTOM_REPO_URL="https://github.com/linux4sam/u-boot-at91.git"
BR2_TARGET_UBOOT_CUSTOM_REPO_VERSION="sama7d65-ea-1.0"
BR2_TARGET_UBOOT_PATCH="$(BR2_EXTERNAL_KSZ_PATH)/patches/u-boot-sama7d65-ea"
BR2_TARGET_UBOOT_BOARD_DEFCONFIG="sama7d65_curiosity_dev_mmc1"
BR2_TARGET_UBOOT_NEEDS_DTC=y
BR2_PACKAGE_HOST_DOSFSTOOLS=y
BR2_PACKAGE_HOST_GENIMAGE=y
BR2_PACKAGE_HOST_MTOOLS=y
BR2_PACKAGE_HOST_UBOOT_TOOLS=y
BR2_PACKAGE_HOST_UBOOT_TOOLS_FIT_SUPPORT=y
BR2_PACKAGE_HOST_UBOOT_TOOLS_ENVIMAGE=y
BR2_PACKAGE_HOST_UBOOT_TOOLS_ENVIMAGE_SOURCE="$(BR2_EXTERNAL_KSZ_PATH)/board/microchip/sama7d65_curiosity/uboot-mmc.txt"
BR2_PACKAGE_HOST_UBOOT_TOOLS_ENVIMAGE_SIZE="0x4000"
BR2_PACKAGE_KSZ_REGS_BIN=y
BR2_PACKAGE_KSZ_PTP_TEST=y
BR2_PACKAGE_MDIO_TOOL=y
```

## ung_apps_external/package/microchip/Config.in
```kconfig
source "$BR2_EXTERNAL_KSZ_PATH/package/microchip/ksz_linuxptp/Config.in"
source "$BR2_EXTERNAL_KSZ_PATH/package/microchip/ksz_linuxptp-3.1.1/Config.in"
source "$BR2_EXTERNAL_KSZ_PATH/package/microchip/ksz_linuxptp-4.0.0/Config.in"
source "$BR2_EXTERNAL_KSZ_PATH/package/microchip/ksz_ptp_scripts/Config.in"
source "$BR2_EXTERNAL_KSZ_PATH/package/microchip/ksz_regs_bin/Config.in"
source "$BR2_EXTERNAL_KSZ_PATH/package/microchip/ksz_ptp_cli/Config.in"
source "$BR2_EXTERNAL_KSZ_PATH/package/microchip/ksz_ptp_test/Config.in"
source "$BR2_EXTERNAL_KSZ_PATH/package/microchip/ksz_OpenAVB/Config.in"
source "$BR2_EXTERNAL_KSZ_PATH/package/microchip/mdio-tool/Config.in"
source "$BR2_EXTERNAL_KSZ_PATH/package/microchip/web_cgi/Config.in"
source "$BR2_EXTERNAL_KSZ_PATH/package/microchip/web_gui/Config.in"
source "$BR2_EXTERNAL_KSZ_PATH/package/microchip/ksz_lan8770_app/Config.in"
```

## ung_apps_external/package/microchip/ksz_ptp_scripts/Config.in
```kconfig
config BR2_PACKAGE_KSZ_PTP_SCRIPTS
	bool "PTP scripts"
	help
	  PTP scripts for use with trying different PTP profiles.
```

## ung_apps_external/package/microchip/ksz_ptp_stack/Config.in
```kconfig
config BR2_PACKAGE_KSZ_PTP_STACK
	bool "Microchip PTP Stack"
	help
	  Microchip PTP Stack.

	  This package builds and installs the userspace 'ptp_stack'
	  command. It is up to the user to ensure that the kernel
	  configuration has all suitable options enabled to allow a
	  proper operation of 'ptp_stack'.
```

## ung_apps_external/package/microchip/web_cgi/Config.in
```kconfig
config BR2_PACKAGE_WEB_CGI
	bool "Microchip WEB CGI"
	help
	  Microchip Web CGI utility.
```

## ung_apps_external/package/microchip/web_gui/Config.in
```kconfig
config BR2_PACKAGE_WEB_GUI
	bool "WEB GUI"
	select BR2_TOOLCHAIN_BUILDROOT_WCHAR
	select BR2_PACKAGE_PYTHON3
	select BR2_PACKAGE_THTTPD
	select BR2_PACKAGE_WEB_CGI
	help
	  WEB GUI Configuration utility.

	  This package builds and installs the web packages.
	  It is up to the user to ensure that the kernel
	  configuration has all suitable options enabled to allow a
	  proper operation of web gui.
```

## ung_apps_external/package/ung_cmake/Config.in
```kconfig
source "$BR2_EXTERNAL_KSZ_PATH/package/ung_cmake/easyrun/Config.in"
source "$BR2_EXTERNAL_KSZ_PATH/package/ung_cmake/ef-loop/Config.in"
```

## ung_apps_external/package/ung_cmake/easyrun/Config.in
```kconfig
config BR2_PACKAGE_EASYRUN
	bool "easyrun"
	select BR2_PACKAGE_ZLIB
	help
	  Microchip easyrun utility.
```

## ung_apps_external/package/ung_cmake/ef-loop/Config.in
```kconfig
config BR2_PACKAGE_EF_LOOP
	bool "ef-loop"
	select BR2_PACKAGE_LIBEV
	help
	  Microchip ef-loop utility.
```
